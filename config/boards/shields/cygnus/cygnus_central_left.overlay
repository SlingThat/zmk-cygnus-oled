/*
 * Copyright (c) 2021 The ZMK Contributors
 *
 * SPDX-License-Identifier: MIT
 */

#include "cygnus.dtsi"

&kscan0 {
    col-gpios
        = <&gpio0 17 GPIO_ACTIVE_HIGH> // col6 in the schematic
        , <&gpio0 20 GPIO_ACTIVE_HIGH> // col5 in the schematic
        , <&gpio0 22 GPIO_ACTIVE_HIGH> // col4 in the schematic
        , <&gpio0 24 GPIO_ACTIVE_HIGH> // col3 in the schematic
        , <&gpio1 00 GPIO_ACTIVE_HIGH>  // col2 in the schematic 
        ;
};
